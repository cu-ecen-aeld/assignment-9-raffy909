## base_external/package/aesd-char-driver/Config.in
```kconfig
config BR2_PACKAGE_AESD_CHAR_DRIVER
	bool "aesd-char-driver"
	help
	  builds and installs aesd kernel module for assignment 8
```

## base_external/package/ldd/Config.in
```kconfig
config BR2_PACKAGE_LDD
	bool "aesd-ldd"
	help
	  Linux device driver package required for assignment 7
	  Used to understand buildroot external trees, package builds, rootfs overlay and handling custom kernel drivers.
```
